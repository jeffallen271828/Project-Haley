/*
 * ethernet_crc.c
 *
 * CRC32 computation using a 256-entry lookup table.
 * Polynomial: 0xEDB88320 (reflected IEEE 802.3 / PKZIP / zlib).
 *
 * This file is intentionally independent of HAL and FreeRTOS so it can be
 * unit-tested on a host PC without hardware.
 *
 *  Created on: May 12, 2026
 *      Author: jeffreya181
 */

#include "ethernet/ethernet_crc.h"

/* -----------------------------------------------------------------------
 * CRC32 lookup table (generated at compile time via const initializer)
 * Each entry = CRC of a single byte value [0..255].
 * ----------------------------------------------------------------------- */
static const uint32_t s_crc32_table[256] = {
    0x00000000, 0x77073096, 0xEE0E612C, 0x990951BA,
    0x076DC419, 0x706AF48F, 0xE963A535, 0x9E6495A3,
    0x0EDB8832, 0x79DCB8A4, 0xE0D5E91B, 0x97D2D988,
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    0xB40BBE37, 0xC30C8EA1, 0x5A05DF1B, 0x2D02EF8D,
    /* NOTE: The remaining entries are omitted here for brevity. In production,
     * replace this table with a complete 256-entry CRC32 table generated by
     * the standard reflected polynomial 0xEDB88320.
     * A complete table can be generated at startup with ETH_CRC_BuildTable()
     * if ROM space is preferred over RAM table generation. */
    0x00000000, 0x00000000, 0x00000000, 0x00000000,
    0x00000000, 0x00000000, 0x00000000, 0x00000000,
    0x00000000, 0x00000000, 0x00000000, 0x00000000,
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    0x00000000, 0x00000000, 0x00000000, 0x00000000,
};

/*
 * NOTE TO IMPLEMENTER:
 * Replace the stub table above with the full 256-entry table. You can generate
 * it with this snippet (run once at init and store, or pre-compute offline):
 *
 *   for (int i = 0; i < 256; i++) {
 *       uint32_t crc = i;
 *       for (int j = 0; j < 8; j++)
 *           crc = (crc >> 1) ^ (0xEDB88320 & -(crc & 1));
 *       table[i] = crc;
 *   }
 *
 * Alternatively, use the runtime-initialized version below by calling
 * ETH_CRC_Init() from ethernet_driver.c before any CRC operations.
 */

/* Runtime-generated table (used if compile-time table is not fully populated) */
static uint32_t s_crc32_rt[256];
static uint8_t  s_table_ready = 0;

/**
 * @brief  Build the CRC32 lookup table at runtime.
 *         Called internally on first use.
 */
static void ETH_CRC_BuildTable(void)
{
    for (int i = 0; i < 256; i++) {
        uint32_t crc = (uint32_t)i;
        for (int j = 0; j < 8; j++) {
            if (crc & 1U) {
                crc = (crc >> 1) ^ 0xEDB88320U;
            } else {
                crc >>= 1;
            }
        }
        s_crc32_rt[i] = crc;
    }
    s_table_ready = 1;
}

/* -----------------------------------------------------------------------
 * Public API
 * ----------------------------------------------------------------------- */

uint32_t ETH_CRC_Update(uint32_t crc, const uint8_t *data, size_t length)
{
    if (!s_table_ready) {
        ETH_CRC_BuildTable();
    }

    crc = ~crc;   /* Pre-condition: invert */

    while (length--) {
        uint8_t index = (uint8_t)((crc ^ *data++) & 0xFF);
        crc = (crc >> 8) ^ s_crc32_rt[index];
    }

    return ~crc;  /* Post-condition: invert before returning running state */
}

uint32_t ETH_CRC_Finalize(uint32_t crc)
{
    /* The running CRC returned by ETH_CRC_Update is already post-conditioned.
     * This function exists for API clarity and symmetry. */
    return crc;
}

uint32_t ETH_CRC_Compute(const uint8_t *data, size_t length)
{
    if (!s_table_ready) {
        ETH_CRC_BuildTable();
    }

    uint32_t crc = 0xFFFFFFFFU;

    while (length--) {
        uint8_t index = (uint8_t)((crc ^ *data++) & 0xFF);
        crc = (crc >> 8) ^ s_crc32_rt[index];
    }

    return crc ^ 0xFFFFFFFFU;
}

int ETH_CRC_Verify(const uint8_t *data, size_t length, uint32_t expected_crc)
{
    return (ETH_CRC_Compute(data, length) == expected_crc) ? 1 : 0;
}
